## LedBlinker/Kconfig
```kconfig
# Copyright (c) 2021 Nordic Semiconductor ASA
# SPDX-License-Identifier: Apache-2.0
#
# This file is the application Kconfig entry point. All application Kconfig
# options can be defined here or included via other application Kconfig files.
# You can browse these options using the west targets menuconfig (terminal) or
# guiconfig (GUI).

menu "Zephyr"
source "Kconfig.zephyr"
endmenu

module = APP
module-str = APP

config FPRIME
	bool "FPrime Support"
# Needed because F Prime uses std::numeric_limits<>.
	select REQUIRES_FULL_LIBCPP
	help
	  This option enables support for the F' library

config APP_WIPE_STORAGE
	bool "Option to clear the MRAM area before mounting"
	help
	  Use this to force a fresh file system to be created.
```
